## config/west.yml
```yaml
manifest:
  remotes:
    - name: zmkfirmware
      url-base: https://github.com/wellitonscheer
  projects:
    - name: zmk
      remote: zmkfirmware
      revision: main
  self:
    path: config
```
